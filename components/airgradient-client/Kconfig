## components/airgradient-client/Kconfig
```kconfig
menu "AirGradient Client"

    config AG_CLIENT_CELLULAR_SUPPORT
        bool "Enable cellular modem support"
        default n
        help
            When enabled, AgClient can use a CellularModem for CoAP and
            MQTT operations, and the CellularHttpClient backend is built
            for OTA use. Adds a build dependency on airgradient-cellular.
            Note: cellular backends are not implemented in the current
            release; enabling this flag has no effect yet.

endmenu
```

## components/airgradient-http-server/Kconfig
```kconfig
menu "AirGradient HTTP Server"

    config AG_HTTP_PORT
        int "Default HTTP listen port"
        range 1 65535
        default 80
        help
            Default port the HTTP server listens on. Products may override
            this at runtime by passing a different value to start().

    config AG_HTTP_MAX_CONNECTIONS
        int "Maximum concurrent connections"
        range 1 16
        default 4
        help
            Maximum number of simultaneous TCP connections the server will
            accept. Passed to esp_http_server as max_open_sockets.

    config AG_HTTP_MAX_BODY_SIZE
        int "Maximum request body size (bytes)"
        range 256 65536
        default 4096
        help
            Upper bound for buffered request bodies. Requests with bodies
            larger than this cap will be truncated to this size before the
            handler runs.

    config AG_HTTP_MAX_ROUTES
        int "Maximum number of registered routes"
        range 4 64
        default 24
        help
            Maximum number of URI handlers the server will accept. Passed
            to esp_http_server as max_uri_handlers. The provisioning
            captive portal registers ~16 routes (API + OS probe URLs),
            so the default must accommodate that with headroom.

endmenu
```

## components/airgradient-sensors/Kconfig
```kconfig
menu "AirGradient Sensors"

    config AVERAGING_ITERATION_INTERVAL_MS
        int "Averaging iteration interval (ms)"
        range 100 10000
        default 2000
        help
            Target wall-clock duration of one averaging iteration inside
            SensorManager::start_measures(). Each iteration polls all active
            sensors and then delays until this many milliseconds have elapsed
            since the iteration started. Lower values increase sampling rate
            at the cost of more CPU / I2C traffic and power.

    config SENSOR_WARMUP_DURATION_MS
        int "Sensor warmup total duration (ms)"
        range 0 60000
        default 10000
        help
            Total default duration of SensorManager::warmup_sensor(). The
            default iteration count passed to warmup_sensor() is derived as
            SENSOR_WARMUP_DURATION_MS / SENSOR_WARMUP_INTERVAL_MS. Used to
            condition TVOC/NOx sensors (e.g. SGP41) and spin up PM sensor
            fans/lasers before the first real measurement.

    config SENSOR_WARMUP_INTERVAL_MS
        int "Sensor warmup iteration interval (ms)"
        range 100 10000
        default 1000
        help
            Duration of a single warmup iteration inside
            SensorManager::warmup_sensor(). Each iteration runs one TVOC/NOx
            conditioning cycle and one PM read, then delays until this many
            milliseconds have elapsed since the iteration started.

    choice SGP41_INDEX_SAMPLING_INTERVAL
        prompt "SGP41 gas-index sampling interval"
        default SGP41_INDEX_SAMPLING_INTERVAL_10S
        help
            Cadence at which the Sensirion gas-index algorithm is fed raw
            SGP41 samples in always-awake modes (Portable / Stationary).
            Sensirion tests only 1 s and 10 s intervals. The 10 s setting
            is recommended to balance index quality against I2C traffic.

        config SGP41_INDEX_SAMPLING_INTERVAL_1S
            bool "1 second"
        config SGP41_INDEX_SAMPLING_INTERVAL_10S
            bool "10 seconds (recommended)"
    endchoice

endmenu
```

## components/airgradient-wifi/Kconfig
```kconfig
menu "AirGradient Wi-Fi"

    config AG_WIFI_DHCP_TIMEOUT_MS
        int "DHCP acquisition timeout (ms)"
        range 1000 60000
        default 15000
        help
            Maximum time WifiManager waits between L2 association
            (IP_EVENT_STA_GOT_IP not delivered yet) and DHCP / static IP
            being applied. ESP-IDF does not expose a DHCP-failure event,
            so the manager arms an internal timer when the STA associates
            and cancels it when the IP is acquired. On expiry the manager
            normalises the disconnect reason to WifiDisconnectReason::dhcp_failed
            and treats it as non-retriable.

endmenu
```
